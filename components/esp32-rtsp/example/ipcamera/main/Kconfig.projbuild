## components/esp32-rtsp/example/ipcamera/main/Kconfig.projbuild
```kconfig
menu "Example Configuration"

    menu "WiFi Settings"

    config ESP_WIFI_SSID
        string "WiFi STA SSID"
        default ""
        help
        WiFi SSID (network name) to connect to or empty for Off.

    config ESP_WIFI_PASSWORD
        string "WiFi STA Password"
        default ""
        help
        WiFi Password if WEP/WPA/WPA2 or empty if Open.
        
    config ESP_WIFI_AP_SSID
        string "WiFi AP SSID"
        default "ESP32-Camera"
        help
        AP SSID (network name) to create or empty for Off.

    config ESP_WIFI_AP_PASSWORD
        string "WiFi AP Password"
        default ""
        help
        AP password for WPA2 or empty for Open.

    config MAX_STA_CONN
        int "Maximal STA connections"
        default 1
        help
        Max number of the STA connects to AP.

    config ESP_WIFI_AP_CHANNEL
        string "WiFi AP Channel"
        default ""
        help
        AP channel for better connection performance.

    config SERVER_IP
        string "WiFi AP IP Address"
        default "192.168.4.1"
        help
            IP address that the ESP will assign to it's AP interface. You can use this IP to connect to the camera after flashing.

    config ESP_MAXIMUM_RETRY
        int "Maximum retry"
        default 5
        help
        Set the Maximum retry to avoid station reconnecting to the AP unlimited when the AP is really inexistent.
    endmenu

    menu "RTSP Settings"

    choice RTSP_ROLE
        prompt "Choose ESP32 role"
        default ESP32_AS_SERVER
        config ESP32_AS_SERVER
            bool "Server"
        config ESP32_AS_CLIENT
            bool "Client"
    endchoice

    config RTSP_SERVER_IP
        depends on ESP32_AS_CLIENT
        string "RTSP Server ip"
        default "192.168.1.1"

    config RTSP_SERVER_PORT
        depends on ESP32_AS_CLIENT
        int "RTSP Server port"
        default 554

    config RTSP_USE_AUDIO
        bool "Use Audio"
        default n

    endmenu

endmenu
```

## components/esp32-rtsp/example/ipcamera/sdkconfig.defaults
```kconfig
CONFIG_ESP32_DEFAULT_CPU_FREQ_240=y
CONFIG_ESP32S2_DEFAULT_CPU_FREQ_240=y
CONFIG_ESP32S3_DEFAULT_CPU_FREQ_240=y

CONFIG_ESPTOOLPY_FLASHSIZE_4MB=y
CONFIG_PARTITION_TABLE_OFFSET=0x10000

CONFIG_FREERTOS_HZ=1000
CONFIG_ESPTOOLPY_FLASHFREQ_80M=y
CONFIG_ESPTOOLPY_FLASHMODE_QIO=y

CONFIG_PARTITION_TABLE_CUSTOM=y
CONFIG_PARTITION_TABLE_CUSTOM_FILENAME="partitions.csv"

CONFIG_ESP32_SPIRAM_SUPPORT=y
CONFIG_ESP32S2_SPIRAM_SUPPORT=y
CONFIG_ESP32S3_SPIRAM_SUPPORT=y
CONFIG_SPIRAM_SPEED_80M=y
CONFIG_SPIRAM=y

CONFIG_HTTPD_MAX_REQ_HDR_LEN=1024

CONFIG_BUTTON_LONG_PRESS_TIME_MS=3000

CONFIG_MEMMAP_SMP=y
CONFIG_LWIP_MAX_SOCKETS=15

#CONFIG_ESP_INT_WDT=n
#CONFIG_ESP_TASK_WDT=n
#
#CONFIG_LWIP_ETHARP_TRUST_IP_MAC=n
CONFIG_LWIP_IRAM_OPTIMIZATION=y

CONFIG_ESP32_WIFI_STATIC_RX_BUFFER_NUM=16
CONFIG_ESP32_WIFI_DYNAMIC_RX_BUFFER_NUM=64
CONFIG_ESP32_WIFI_DYNAMIC_TX_BUFFER_NUM=64
CONFIG_ESP32_WIFI_AMPDU_TX_ENABLED=y
CONFIG_ESP32_WIFI_TX_BA_WIN=32
CONFIG_ESP32_WIFI_AMPDU_RX_ENABLED=y
CONFIG_ESP32_WIFI_RX_BA_WIN=32

CONFIG_LWIP_TCP_SND_BUF_DEFAULT=65534
CONFIG_LWIP_TCP_WND_DEFAULT=65534
CONFIG_LWIP_TCP_RECVMBOX_SIZE=64
CONFIG_LWIP_UDP_RECVMBOX_SIZE=64
CONFIG_LWIP_TCPIP_RECVMBOX_SIZE=64

CONFIG_LWIP_SNTP_UPDATE_DELAY=60000
CONFIG_LWIP_SNTP_MAX_SERVERS=5
CONFIG_ESP32_TIME_SYSCALL_USE_FRC1=y
```

## components/onenet/Kconfig.projbuild
```kconfig
menu "OneNET Configuration"
    config ONENET_PRODUCT_ID
        string "Product ID"
        default ""
        help
            product id of onenet

    config ONENET_DEV_ID
        string "Device ID"
        default ""
        help
            device id of onenet

    config ONENET_KEY
        string "API key"
        default ""
        help
            api key of onenet

    config ONENET_AUTH_INFO
        string "Auth info"
        default ""
        help
            auth info of onenet
    
endmenu
```

## sdkconfig.defaults
```kconfig
CONFIG_ESPTOOLPY_BAUD_921600B=y
CONFIG_FLASHMODE_QIO=y
CONFIG_ESPTOOLPY_FLASHFREQ_80M=y
CONFIG_ESPTOOLPY_FLASHSIZE_4MB=y
CONFIG_HTTPD_MAX_REQ_HDR_LEN=1024
#
# Partition Table
#
CONFIG_PARTITION_TABLE_CUSTOM=y
CONFIG_PARTITION_TABLE_CUSTOM_FILENAME="partitions.csv"
CONFIG_PARTITION_TABLE_OFFSET=0x10000

#
# Camera configuration
#
CONFIG_ENABLE_TEST_PATTERN=
CONFIG_OV2640_SUPPORT=y
CONFIG_OV7725_SUPPORT=
CONFIG_CAMERA_MODEL_AI_THINKER=y
CONFIG_CAMERA_MODEL_WROVER_KIT=n
CONFIG_ESP_FACE_DETECT_ENABLED=n
CONFIG_ESP_FACE_RECOGNITION_ENABLED=n
#
# ESP32-specific
#
CONFIG_ESP32_DEFAULT_CPU_FREQ_240=y
CONFIG_SPIRAM_SUPPORT=y
CONFIG_ESP32S3_SPIRAM_SUPPORT=y
CONFIG_SPIRAM_SPEED_80M=y

CONFIG_FREERTOS_HZ=500

CONFIG_FATFS_LFN_STACK=y
CONFIG_FATFS_MAX_LFN=127

CONFIG_LCD_DRIVER_SCREEN_CONTROLLER_ILI9341=n
CONFIG_LCD_DRIVER_SCREEN_CONTROLLER_ST7789=y
```

## sdkconfig.defaults.esp32s3
```kconfig
CAMERA_MODULE_ESP_S3_EYE=y

CONFIG_ESP32S3_DEFAULT_CPU_FREQ_240=y
CONFIG_SPIRAM_SUPPORT=y
CONFIG_ESP32S3_SPIRAM_SUPPORT=y
CONFIG_SPIRAM_MODE_OCT=y
CONFIG_ESP_CONSOLE_USB_SERIAL_JTAG=y
CONFIG_SPI_FLASH_USE_LEGACY_IMPL=y
```
